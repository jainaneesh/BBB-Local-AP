## meta-bbb/conf/distro/bbb-router.conf
```bitbake
# meta-bbb/conf/distro/bbb-router.conf

require conf/distro/poky.conf

BB_NUMBER_THREADS = "4"
BB_NUMBER_PARSE_THREADS = "4"
PARALLEL_MAKE = "-j 4"
BB_TASK_NICE_LEVEL = "10"

DISTRO_NAME = "BBB Router Distro"
DISTRO_VERSION = "1.0"

# Use systemd
DISTRO_FEATURES:append = " usrmerge systemd"
VIRTUAL-RUNTIME_init_manager = "systemd"
VIRTUAL-RUNTIME_initscripts = ""
DISTRO_FEATURES:remove = " sysvinit"

# nftables userspace + kernel feature flag
DISTRO_FEATURES:append = " nftables"

# Prefer iptables that uses nft backend (modern)
# Provider is still "iptables", but it will build iptables with nft backend
PREFERRED_PROVIDER_virtual/iptables = "iptables"

# Image format
IMAGE_FSTYPES += " wic wic.bmap ext4"
```

## meta-bbb/wic/bbb-router-2part.wks
```
# short-description: Create SD card image with 2 partitions
# long-description: Creates a partitioned SD card image for TI platforms.
# Boot files are located in the first vfat partition with extra reserved space.

part --source bootimg-partition --sourceparams="loader=u-boot" --fstype=vfat --label boot --active --align 1024 --use-uuid --fixed-size 128M
part / --source rootfs --fstype=ext4 --label root --align 1024 --use-uuid

bootloader --append="root=/dev/mmcblk0p2 rootfstype=ext4 rootwait rw console=ttyS0,115200n8"
```
